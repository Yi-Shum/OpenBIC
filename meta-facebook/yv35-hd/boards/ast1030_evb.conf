## meta-facebook/yv35-hd/boards/ast1030_evb.conf
```kconfig
CONFIG_GPIO_ASPEED_SGPIOM=n
CONFIG_GPIO_ASPEED=y
CONFIG_SPI_ASPEED=y
CONFIG_I2C_ASPEED=y
CONFIG_ADC_ASPEED=y
CONFIG_JTAG_ASPEED=y
CONFIG_PWM_ASPEED=n
CONFIG_TACH_ASPEED=n
CONFIG_ESPI_ASPEED=y
CONFIG_PECI_ASPEED=n
CONFIG_PECI_ASPEED_INTERRUPT_DRIVEN=n
CONFIG_USB_ASPEED=y
CONFIG_I3C_ASPEED=n
CONFIG_CRYPTO=n
CONFIG_CRYPTO_ASPEED=n
CONFIG_RSA_ASPEED=n
CONFIG_WDT_ASPEED=y
# todo: zephyr kernel 00.01.05 support 4 bytes post code read, need disable snoop and enable PCC
CONFIG_SNOOP_ASPEED=n

CONFIG_ADC_ASPEED_ACQUISITION_THREAD_STACK_SIZE=512
CONFIG_SYSTEM_WORKQUEUE_STACK_SIZE=2048
CONFIG_IDLE_STACK_SIZE=512
```
